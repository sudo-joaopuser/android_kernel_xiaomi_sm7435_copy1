/dts-v1/;
/plugin/;

#include <dt-bindings/clock/qcom,gcc-parrot.h>
#include <dt-bindings/clock/qcom,camcc-parrot.h>
#include <dt-bindings/interconnect/qcom,parrot.h>
#include <dt-bindings/interrupt-controller/arm-gic.h>
#include <dt-bindings/regulator/qcom,rpmh-regulator-levels.h>

#include "garnet-camera-sensor-qrd.dtsi"
/ {
	model = "Qualcomm Technologies, Inc. Garnet based on SM7435";
	compatible = "qcom,parrot-qrd", "qcom,parrot", "qcom,qrd";
	qcom,msm-id = <0x247 0x10000 0x219 0x10000 0x265 0x10000>;
	qcom,board-id = <0x1000B 0x0>;
	xiaomi,miboard-id = <0x11 0x0>;
};
